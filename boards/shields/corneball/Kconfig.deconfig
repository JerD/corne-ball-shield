## boards/shields/corneball/Kconfig.deconfig
```kconfig
if SHIELD_CORNEBALL_DONGLE

config ZMK_KEYBOARD_NAME
    default "corneball"

config ZMK_SPLIT_ROLE_CENTRAL
    default y

config ZMK_SPLIT_BLE_CENTRAL_PERIPHERALS
    default 2

config ZMK_USB
    default y

endif

if SHIELD_CORNEBALL_LEFT || SHIELD_CORNEBALL_RIGHT || SHIELD_CORNEBALL_DONGLE

config ZMK_SPLIT
    default y

config ZMK_BLE
    default y

endif
```

## boards/shields/corneball/Kconfig.shield
```kconfig
config SHIELD_CORNEBALL_LEFT
    def_bool $(shields_list_contains,corneball_left)

config SHIELD_CORNEBALL_RIGHT
    def_bool $(shields_list_contains,corneball_right)

config SHIELD_CORNEBALL_DONGLE
    def_bool $(shields_list_contains,corneball_dongle)
```
